# file: Project.ioc
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Mcu.Family=STM32F0
Mcu.Name=STM32F051R8Tx
Mcu.Package=LQFP64
NVIC.TIM14_IRQn=true\:1\:0
PA8.Mode=Clock-out
PA8.Signal=RCC_MCO
PF0-OSC_IN.Mode=HSE-External-Clock-Source
PF0-OSC_IN.Signal=RCC_OSC_IN
ProjectManager.TargetToolchain=EWARM 6.70
RCC.AHBFreq_Value=48000000
RCC.APB1Freq_Value=48000000
RCC.APB1TimFreq_Value=48000000
RCC.CECEnable-ClockTree=false
RCC.EnableHSE-ClockTree=true
RCC.EnableHSERTCDevisor-ClockTree=false
RCC.EnableLSE-ClockTree=false
RCC.EnableLSERTC-ClockTree=false
RCC.EnableMCOMultDivisor-ClockTree=false
RCC.FLatency-AdvancedSettings=FLASH_LATENCY_1
RCC.HCLKFreq_Value=48000000
RCC.HSEState-ClockTree=RCC_HSE_BYPASS
RCC.HSI14State-ClockTree=RCC_HSI14_OFF
RCC.HSI48State-ClockTree=RCC_HSI48_OFF
RCC.HSIState-ClockTree=RCC_HSI_ON
RCC.I2C1Enable-ClockTree=false
RCC.IWDGEnable-ClockTree=false
RCC.LSIState-ClockTree=RCC_LSI_OFF
RCC.MCOEnable-ClockTree=true
RCC.OscillatorTypeHSI-ClockTree=RCC_OSCILLATORTYPE_HSI
RCC.PLLMUL=RCC_PLL_MUL6
RCC.PLLSourceVirtual=RCC_PLLSOURCE_HSE
RCC.PLLState-ClockTree=RCC_PLL_ON
RCC.PREFETCH_ENABLE-AdvancedSettings=1
RCC.RCC_MCODiv-ClockTree=RCC_MCO_NODIV
RCC.RCC_MCOSource=RCC_MCOSOURCE_HSI
RCC.RTCEnable-ClockTree=false
RCC.SYSCLKFreq_VALUE=48000000
RCC.SYSCLKSource=RCC_SYSCLKSOURCE_PLLCLK
RCC.USART1Enable-ClockTree=false
RCC.USART2Enable-ClockTree=false
RCC.USBEnable-ClockTree=false
TIM14.Channel-Input_Capture1_from_TI1_REMAP_TIM14=TIM_CHANNEL_1
TIM14.CounterMode-Enable_Timer=TIM_COUNTERMODE_UP
TIM14.CounterMode-Input_Capture1_from_TI1_REMAP_TIM14=TIM_COUNTERMODE_UP
TIM14.ICSelection-Input_Capture1_from_TI1_REMAP_TIM14=TIM_ICSELECTION_DIRECTTI
TIM14.Period=65535
TIM14.TIM14_TI1_REMAP=TIM_TIM14_MCO
VP_TIM14_VS_ClockSourceINT.Mode=Enable_Timer
VP_TIM14_VS_NoInput1.Mode=Input_Capture1_from_TI1_REMAP_TIM14

// file: Src/main.c
/**
  ******************************************************************************
  * File Name          : main.c
  * Date               : 15/10/2014 15:53:58
  * Description        : Main program body
  ******************************************************************************
  *
  * COPYRIGHT(c) 2014 STMicroelectronics
  *
  * Redistribution and use in source and binary forms, with or without modification,
  * are permitted provided that the following conditions are met:
  *   1. Redistributions of source code must retain the above copyright notice,
  *      this list of conditions and the following disclaimer.
  *   2. Redistributions in binary form must reproduce the above copyright notice,
  *      this list of conditions and the following disclaimer in the documentation
  *      and/or other materials provided with the distribution.
  *   3. Neither the name of STMicroelectronics nor the names of its contributors
  *      may be used to endorse or promote products derived from this software
  *      without specific prior written permission.
  *
  * THIS SOFTWARE IS PROVIDED BY THE COPYRIGHT HOLDERS AND CONTRIBUTORS "AS IS"
  * AND ANY EXPRESS OR IMPLIED WARRANTIES, INCLUDING, BUT NOT LIMITED TO, THE
  * IMPLIED WARRANTIES OF MERCHANTABILITY AND FITNESS FOR A PARTICULAR PURPOSE ARE
  * DISCLAIMED. IN NO EVENT SHALL THE COPYRIGHT HOLDER OR CONTRIBUTORS BE LIABLE
  * FOR ANY DIRECT, INDIRECT, INCIDENTAL, SPECIAL, EXEMPLARY, OR CONSEQUENTIAL
  * DAMAGES (INCLUDING, BUT NOT LIMITED TO, PROCUREMENT OF SUBSTITUTE GOODS OR
  * SERVICES; LOSS OF USE, DATA, OR PROFITS; OR BUSINESS INTERRUPTION) HOWEVER
  * CAUSED AND ON ANY THEORY OF LIABILITY, WHETHER IN CONTRACT, STRICT LIABILITY,
  * OR TORT (INCLUDING NEGLIGENCE OR OTHERWISE) ARISING IN ANY WAY OUT OF THE USE
  * OF THIS SOFTWARE, EVEN IF ADVISED OF THE POSSIBILITY OF SUCH DAMAGE.
  *
  ******************************************************************************
  */

#include "stm32f0xx_hal.h"

TIM_HandleTypeDef htim14;

/* USER CODE BEGIN PV */
//uint32_t frequency;
//uint32_t capture1;
//uint32_t capture2;
/* USER CODE END PV */

void SystemClock_Config(void);
static void MX_GPIO_Init(void);
static void MX_TIM14_Init(void);

int main(void)
{

  /* MCU Configuration----------------------------------------------------------*/

  /* Reset of all peripherals, Initializes the Flash interface and the Systick. */
  HAL_Init();

  /* Configure the system clock */
  SystemClock_Config();

  /* Initialize all configured peripherals */
  MX_GPIO_Init();
  MX_TIM14_Init();

  /* USER CODE BEGIN 2 */
  HAL_TIM_IC_Start_IT(&htim14, TIM_CHANNEL_1);

  /* USER CODE END 2 */

  while (1)
  {
  }

}

/** System Clock Configuration
*/
void SystemClock_Config(void)
{

  RCC_OscInitTypeDef RCC_OscInitStruct;
  RCC_ClkInitTypeDef RCC_ClkInitStruct;

  RCC_OscInitStruct.OscillatorType = RCC_OSCILLATORTYPE_HSI;
  RCC_OscInitStruct.HSEState = RCC_HSE_BYPASS;
  RCC_OscInitStruct.HSIState = RCC_HSI_ON;
  RCC_OscInitStruct.HSICalibrationValue = 16;
  RCC_OscInitStruct.PLL.PLLState = RCC_PLL_ON;
  RCC_OscInitStruct.PLL.PLLSource = RCC_PLLSOURCE_HSE;
  RCC_OscInitStruct.PLL.PLLMUL = RCC_PLL_MUL6;
  RCC_OscInitStruct.PLL.PREDIV = RCC_PREDIV_DIV1;
  HAL_RCC_OscConfig(&RCC_OscInitStruct);

  RCC_ClkInitStruct.ClockType = RCC_CLOCKTYPE_SYSCLK;
  RCC_ClkInitStruct.SYSCLKSource = RCC_SYSCLKSOURCE_PLLCLK;
  RCC_ClkInitStruct.AHBCLKDivider = RCC_SYSCLK_DIV1;
  RCC_ClkInitStruct.APB1CLKDivider = RCC_HCLK_DIV1;
  HAL_RCC_ClockConfig(&RCC_ClkInitStruct, FLASH_LATENCY_1);

  HAL_RCC_MCOConfig(RCC_MCO, RCC_MCOSOURCE_HSI, RCC_MCO_NODIV);

  __SYSCFG_CLK_ENABLE();

}

/* TIM14 init function */
void MX_TIM14_Init(void)
{

  TIM_IC_InitTypeDef sConfigIC;

  htim14.Instance = TIM14;
  htim14.Init.Prescaler = 0;
  htim14.Init.CounterMode = TIM_COUNTERMODE_UP;
  htim14.Init.Period = 65535;
  htim14.Init.ClockDivision = TIM_CLOCKDIVISION_DIV1;
  HAL_TIM_Base_Init(&htim14);

  HAL_TIM_IC_Init(&htim14);

  sConfigIC.ICPolarity = TIM_INPUTCHANNELPOLARITY_RISING;
  sConfigIC.ICSelection = TIM_ICSELECTION_DIRECTTI;
  sConfigIC.ICPrescaler = TIM_ICPSC_DIV1;
  sConfigIC.ICFilter = 0;
  HAL_TIM_IC_ConfigChannel(&htim14, &sConfigIC, TIM_CHANNEL_1);

  HAL_TIMEx_RemapConfig(&htim14, TIM_TIM14_MCO);

}

/** Configure pins as
        * Analog
        * Input
        * Output
        * EVENT_OUT
        * EXTI
     PA8   ------> RCC_MCO
*/
void MX_GPIO_Init(void)
{

  GPIO_InitTypeDef GPIO_InitStruct;

  /* GPIO Ports Clock Enable */
  __GPIOF_CLK_ENABLE();
  __GPIOA_CLK_ENABLE();

  /*Configure GPIO pin : PA8 */
  GPIO_InitStruct.Pin = GPIO_PIN_8;
  GPIO_InitStruct.Mode = GPIO_MODE_AF_PP;
  GPIO_InitStruct.Pull = GPIO_NOPULL;
  GPIO_InitStruct.Speed = GPIO_SPEED_LOW;
  GPIO_InitStruct.Alternate = GPIO_AF0_MCO;
  HAL_GPIO_Init(GPIOA, &GPIO_InitStruct);

}

/* USER CODE BEGIN 4 */
void HAL_TIM_IC_CaptureCallback(TIM_HandleTypeDef *htim)
{
  /* NOTE : This function Should not be modified, when the callback is needed,
            the __HAL_TIM_IC_CaptureCallback could be implemented in the user file
   */

//  if (capture1 == 0)
//  {
//    capture1 = HAL_TIM_ReadCapturedValue(htim, TIM_CHANNEL_1);
//  }
//  else
//  {
//    capture2 = HAL_TIM_ReadCapturedValue(htim, TIM_CHANNEL_1);
//
//
//    if (capture1 > capture2)
//    {
//      frequency = (48000000 / (capture1 - capture2));
//    }
//    else
//    {
//      frequency = (48000000 / (capture2 - capture1));
//    }
//
//    capture1 = 0;
//    capture2 = 0;
//  }

}
/* USER CODE END 4 */

/************************ (C) COPYRIGHT STMicroelectronics *****END OF FILE****/
